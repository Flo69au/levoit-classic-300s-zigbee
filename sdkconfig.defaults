## sdkconfig.defaults
```kconfig
# Zigbee
CONFIG_ZB_ENABLED=y
CONFIG_ZB_ZCZR=n
CONFIG_ZB_ZED=y

# Zigbee stack
CONFIG_ESP_ZB_TRACE_ENABLE=n

# Partition table custom (requis pour zb_storage)
CONFIG_PARTITION_TABLE_CUSTOM=y
CONFIG_PARTITION_TABLE_CUSTOM_FILENAME="partitions.csv"

# Flash
CONFIG_ESPTOOLPY_FLASHSIZE_2MB=y

# FreeRTOS
CONFIG_FREERTOS_HZ=1000

# Log
CONFIG_LOG_DEFAULT_LEVEL_INFO=y
```
